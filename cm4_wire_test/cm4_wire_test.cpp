/*
 * cm4_wire_test — Phase-3.2: the CM4 SELF-CONFIGURES LPI2C5 (the on-board
 * codec bus) and runs three polled I2C master transactions against the REAL
 * WM8962 codec @0x1A.  This CM7 sketch only boots the CM4 image and reports
 * the CM4's observations over the MU on LPUART1 — it never touches
 * Wire/LPI2C (LPI2C5 is CM4-exclusive in 3.2).
 *
 * Tokens over Serial1 (LPUART1), streamed by the CM4 over MU channel 0:
 *   mcr   = 00000001   LPI2C MCR.MEN — the CM4 enabled the master block
 *   lpcg  = ........   CCM_LPCG102 readback (informative — not asserted)
 *   croot = ........   CCM_CLOCK_ROOT41 readback (informative — not asserted)
 *   ack   = 00000000   reset-write R15<-0x6243 to WM8962 @0x1A ACKed (err 0)
 *   nack  = 00000002   probe of absent address 0x2A NACKed (addr-NACK err 2)
 *   rdn   = 00000002   ID read-back of R15 returned 2 bytes
 *   rdv   = ????????   the 16-bit read value — WORLD-SPLIT by design:
 *                      QEMU wm8962-stub reads 0x0000; real silicon answers
 *                      the WM8962 device ID 0x6243.  NOT folded into PASS
 *                      here; each world's checker asserts its own value.
 *   done  = 00000001   CM4 sequence completed
 * Verdict: WIRE_CM4=PASS requires mcr/ack/nack/rdn/done at expected values.
 */
#include "Arduino.h"
#include "core_pins.h"
#include "HardwareSerial.h"
#include "Multicore.h"
#include "MessagingUnit.h"
#include "cm4_wire.h"     /* generated by teensy_add_cm4_image */

#define WAIT_LONG 3000000u

static void phex(const char *k, uint32_t v)
{
    Serial1.print(k);
    Serial1.print('=');
    for (int i = 28; i >= 0; i -= 4) {
        Serial1.print("0123456789ABCDEF"[(v >> i) & 0xF]);
    }
    Serial1.println();
}

static void ptimeout(const char *k)
{
    Serial1.print(k);
    Serial1.println("=TIMEOUT");
}

static bool wait_recv(uint8_t ch, uint32_t *out)
{
    for (uint32_t n = WAIT_LONG; n; n--) {
        if (MU.tryReceive(ch, out)) {
            return true;
        }
    }
    return false;
}

void setup()
{
    Serial1.begin(115200);
    Serial1.println("CM4WIRE-GATE v1");

    MU.begin();
    Multicore.begin(cm4_wire, sizeof(cm4_wire));

    static const char *labels[8] =
        { "mcr", "lpcg", "croot", "ack", "nack", "rdn", "rdv", "done" };
    uint32_t v[8];
    bool ok = true;
    for (int i = 0; i < 8; i++) {
        if (wait_recv(0, &v[i])) {
            phex(labels[i], v[i]);
        } else {
            ptimeout(labels[i]);
            v[i] = 0xFFFFFFFFu;
            ok = false;
        }
    }

    /* rdv (v[6]) is intentionally NOT part of PASS — world-dependent. */
    bool pass = ok
        && v[0] == 0x1u          /* mcr.MEN */
        && v[3] == 0x0u          /* ack: reset write ACKed */
        && v[4] == 0x2u          /* nack: addr-NACK at 0x2A */
        && v[5] == 0x2u          /* rdn: 2 bytes read back */
        && v[7] == 0x1u;         /* done */
    Serial1.println(pass ? "WIRE_CM4=PASS" : "WIRE_CM4=FAIL");
    Serial1.println("CM4WIRE-DONE");
}

void loop()
{
}
