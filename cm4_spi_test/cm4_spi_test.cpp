/*
 * cm4_spi_test — Phase-3.1: the CM4 SELF-CONFIGURES LPSPI1 and runs a polled
 * master self-loopback (external SDO->SDI jumper).  This CM7 sketch only boots
 * the CM4 image and reports the CM4's observations over the MU on LPUART1 — it
 * never touches LPSPI1 (LPSPI1 is CM4-exclusive in 3.1).
 *
 * Tokens over Serial1 (LPUART1), streamed by the CM4 over MU channel 0:
 *   cr    = 00000001   LPSPI CR.MEN — the CM4 enabled the block
 *   cfgr1 = 00000001   CFGR1.MASTER — master mode
 *   lpcg  = ........   CCM_LPCG104 readback (informative — not asserted)
 *   croot = ........   CCM_CLOCK_ROOT43 readback (informative — not asserted)
 *   a     = 000000A5   loopback echoed 0xA5   (8-bit)
 *   b     = 0000003C   loopback echoed 0x3C   (8-bit)
 *   w     = 0000BEEF   transfer16 echoed 0xBEEF (16-bit)
 *   buf   = DEADBEEF   4-byte buffer echoed {DE,AD,BE,EF}
 *   rxok  = 00000001   all loopback bytes matched
 * Verdict: SPI_CM4=PASS.  (In QEMU the ssi-loopback child echoes on CR.MEN
 * alone; on hardware the same tokens additionally prove the CM4's clock-gate +
 * pin-mux via the physical jumper — see README.)
 */
#include "Arduino.h"
#include "core_pins.h"
#include "HardwareSerial.h"
#include "Multicore.h"
#include "MessagingUnit.h"
#include "cm4_spi.h"     /* generated by teensy_add_cm4_image */

#define WAIT_LONG 3000000u

static void phex(const char *k, uint32_t v)
{
    Serial1.print(k);
    Serial1.print('=');
    for (int i = 28; i >= 0; i -= 4) {
        Serial1.print("0123456789ABCDEF"[(v >> i) & 0xF]);
    }
    Serial1.println();
}

static void ptimeout(const char *k)
{
    Serial1.print(k);
    Serial1.println("=TIMEOUT");
}

static bool wait_recv(uint8_t ch, uint32_t *out)
{
    for (uint32_t n = WAIT_LONG; n; n--) {
        if (MU.tryReceive(ch, out)) {
            return true;
        }
    }
    return false;
}

void setup()
{
    Serial1.begin(115200);
    Serial1.println("CM4SPI-GATE v1");

    MU.begin();
    Multicore.begin(cm4_spi, sizeof(cm4_spi));

    static const char *labels[9] =
        { "cr", "cfgr1", "lpcg", "croot", "a", "b", "w", "buf", "rxok" };
    uint32_t v[9];
    bool ok = true;
    for (int i = 0; i < 9; i++) {
        if (wait_recv(0, &v[i])) {
            phex(labels[i], v[i]);
        } else {
            ptimeout(labels[i]);
            v[i] = 0xFFFFFFFFu;
            ok = false;
        }
    }

    bool pass = ok
        && v[0] == 0x1u && v[1] == 0x1u          /* cr.MEN, cfgr1.MASTER */
        && v[4] == 0xA5u && v[5] == 0x3Cu        /* a, b */
        && v[6] == 0xBEEFu && v[7] == 0xDEADBEEFu /* w, buf */
        && v[8] == 0x1u;                          /* rxok */
    Serial1.println(pass ? "SPI_CM4=PASS" : "SPI_CM4=FAIL");
    Serial1.println("CM4SPI-DONE");
}

void loop()
{
}
