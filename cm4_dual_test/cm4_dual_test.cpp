/*
 * cm4_dual_test - Phase-2D CAPSTONE: dual-sketch blink + IPC.
 *
 * Two independent sketches run concurrently and cooperate:
 *   - CM7 (this, the Arduino core): blinks LED_BUILTIN (GPIO3.3) and drives an
 *     MU IPC exchange with the CM4.
 *   - CM4 (a real compiled image, cm4/): drives its OWN GPIO output (GPIO5.12)
 *     and answers IPC requests with a compute.
 *
 * Tokens over Serial1 (LPUART1):
 *   cm7led  = 00000001   CM7 left its LED driven high (register-confirmed)
 *   cm4gpio = 00001000   the CM4 drove GPIO5.12 high (its own DR readback)
 *   cm7sees = 00001000   the CM7 reads the same GPIO5.DR (cross-core shared
 *                        peripheral: the CM4's GPIO write is visible to the CM7)
 *   ipc     = 00000037   bidirectional IPC: CM7 sent 0x10, the CM4 replied
 *                        f(0x10)=0x10*3+7=0x37 from its MU interrupt handler
 *
 * (PSR readback of an output is deliberately NOT used: silicon reflects the
 * driven pad but the qemu2 imxrt_gpio model masks output bits from PSR, so DR
 * readback is the QEMU/silicon-consistent check.)
 */
#include "Arduino.h"
#include "core_pins.h"
#include "HardwareSerial.h"
#include "Multicore.h"
#include "MessagingUnit.h"
#include "cm4_dual.h"     /* generated by teensy_add_cm4_image */

/* GPIO5 (the CM4's blink port) — read cross-core from the CM7. */
#define GPIO5_DR_RD (*(volatile uint32_t *)(GPIO5_BASE + 0x00u))
#define CM4_GPIO_BIT (1u << 12)

#define WAIT_LONG 3000000u

static void phex(const char *k, uint32_t v)
{
    Serial1.print(k);
    Serial1.print('=');
    for (int i = 28; i >= 0; i -= 4) {
        Serial1.print("0123456789ABCDEF"[(v >> i) & 0xF]);
    }
    Serial1.println();
}

static void ptimeout(const char *k)
{
    Serial1.print(k);
    Serial1.println("=TIMEOUT");
}

static bool wait_recv(uint8_t ch, uint32_t *out)
{
    for (uint32_t n = WAIT_LONG; n; n--) {
        if (MU.tryReceive(ch, out)) {
            return true;
        }
    }
    return false;
}

void setup()
{
    uint32_t v;

    Serial1.begin(115200);
    Serial1.println("CM4DUAL-GATE v1");

    MU.begin();
    Multicore.begin(cm4_dual, sizeof(cm4_dual));

    /* --- CM7 blink: toggle LED_BUILTIN (GPIO3.3) a few times, leave it high.
     * Read the LED state from DR bit 3, not digitalRead()/PSR: the qemu2 model
     * masks output bits from PSR (as for the CM4's GPIO), so DR is the
     * QEMU/silicon-consistent readback. --- */
    pinMode(LED_BUILTIN, OUTPUT);
    for (int i = 0; i < 6; i++) {
        digitalWrite(LED_BUILTIN, (i & 1) ? LOW : HIGH);
    }
    digitalWrite(LED_BUILTIN, HIGH);
    phex("cm7led", (GPIO3_DR >> 3) & 1u);

    /* --- CM4 blink: the CM4 reports its own GPIO5 DR after driving it high --- */
    if (wait_recv(0, &v)) { phex("cm4gpio", v); } else { ptimeout("cm4gpio"); }

    /* --- cross-core: the CM7 reads the same GPIO5 the CM4 drove --- */
    phex("cm7sees", GPIO5_DR_RD & CM4_GPIO_BIT);

    /* --- IPC: CM7 sends 0x10, the CM4's ISR replies f(0x10)=0x37 --- */
    MU.send(3, 0x10u);
    if (wait_recv(3, &v)) { phex("ipc", v); } else { ptimeout("ipc"); }

    Serial1.println("CM4DUAL-DONE");
}

void loop()
{
}
