/*
 * cm4_wire_int_master_test — Phase 4.1 (HW-VERIFIED): the CM4 self-configures
 * LPI2C5 and reads the WM8962 device ID over a HYBRID master — the register-
 * pointer WRITE is polled (shared lpi2c1176_master_write) and only the DATA
 * READ is interrupt-driven (LPI2C5_IRQHandler on the CM4's own NVIC, via the
 * qemu2 split-IRQ — the first non-MU peripheral IRQ routed to the CM4).
 * Silicon-truth: a fully-ISR master raced the cold-bus repeated-START (the
 * WM8962 never latched the register pointer → read 0x0000 with a false PASS);
 * see main_cm4.c. The CM7 only boots the CM4 image and reports MU tokens on
 * LPUART1.
 *
 * Tokens (MU ch0, fixed order):
 *   irqcnt = >0         CM4 serviced the LPI2C5 IRQ (isolated routing proof)
 *   mcr    = 00000001   LPI2C MCR.MEN — master enabled
 *   lpcg   = ........    CCM_LPCG102 readback (informative)
 *   croot  = ........    CCM_CLOCK_ROOT41 readback (informative)
 *   rdv    = ????????    R15 ID read by the CM4 ISR — WORLD-SPLIT:
 *                        QEMU wm8962-stub = 0x0000; silicon = 0x6243
 *   err    = 00000000    ISR outcome (0 = OK; asserted in both worlds)
 *   done   = 00000001   CM4 sequence completed
 * WIRE_INT_MASTER_CM4=PASS requires irqcnt>0, mcr=1, err=0, done=1.
 */
#include "Arduino.h"
#include "core_pins.h"
#include "HardwareSerial.h"
#include "Multicore.h"
#include "MessagingUnit.h"
#include "cm4_wire_int_master.h"   /* generated by teensy_add_cm4_image */

#define WAIT_LONG 3000000u

static void phex(const char *k, uint32_t v)
{
    Serial1.print(k); Serial1.print('=');
    for (int i = 28; i >= 0; i -= 4)
        Serial1.print("0123456789ABCDEF"[(v >> i) & 0xF]);
    Serial1.println();
}
static void ptimeout(const char *k) { Serial1.print(k); Serial1.println("=TIMEOUT"); }

static bool wait_recv(uint8_t ch, uint32_t *out)
{
    for (uint32_t n = WAIT_LONG; n; n--)
        if (MU.tryReceive(ch, out)) return true;
    return false;
}

void setup()
{
    Serial1.begin(115200);
    Serial1.println("CM4WIREINT-GATE v1");

    MU.begin();
    Multicore.begin(cm4_wire_int_master, sizeof(cm4_wire_int_master));

    static const char *labels[7] = { "irqcnt", "mcr", "lpcg", "croot", "rdv", "err", "done" };
    uint32_t v[7];
    bool ok = true;
    for (int i = 0; i < 7; i++) {
        if (wait_recv(0, &v[i])) phex(labels[i], v[i]);
        else { ptimeout(labels[i]); v[i] = 0xFFFFFFFFu; ok = false; }
    }

    /* rdv (v[4]) is world-dependent -> NOT folded into PASS. */
    bool pass = ok
        && v[0] != 0x0u          /* irqcnt: CM4 took the LPI2C5 IRQ */
        && v[1] == 0x1u          /* mcr.MEN */
        && v[5] == 0x0u          /* err: transaction OK (no NDF/ALF/FEF) */
        && v[6] == 0x1u;         /* done */
    Serial1.println(pass ? "WIRE_INT_MASTER_CM4=PASS" : "WIRE_INT_MASTER_CM4=FAIL");
    Serial1.println("CM4WIREINT-DONE");
}

void loop() {}
