/*
 * cm4_wire_dma_test — Phase 4 eDMA_LPSR DMA-Wire (RED SCAFFOLD, Task 3):
 * the CM4 will self-configure LPI2C5 + eDMA_LPSR and DMA-read the WM8962 device
 * ID, with the eDMA_LPSR channel-0 completion IRQ firing on the CM4's OWN NVIC
 * (dmairq>0) — the true CM4 interrupt-DMA proof the main eDMA cannot deliver
 * (its channel IRQs are CM7-domain, RM Table 4-1). The CM7 only boots the CM4
 * image and reports MU tokens on LPUART1.
 *
 * In this Task-3 scaffold the CM4 emits only READY, so croot/rdv/dmairq/err/done
 * TIMEOUT and the gate ends WIRE_DMA_CM4=FAIL — the intended RED. Task 4 (GREEN)
 * makes the CM4 DMA the read and take the eDMA_LPSR IRQ, yielding dmairq>0.
 *
 * Tokens (MU ch0, fixed order):
 *   ready  = CAFE0001   CM4 alive
 *   croot  = ........   CCM_CLOCK_ROOT41 readback (informative)
 *   rdv    = ????????   WM8962 R15 ID DMA'd by eDMA_LPSR — WORLD-SPLIT:
 *                       QEMU wm8962-stub = 0x0000; silicon = 0x6243 (asserted HW-side)
 *   dmairq = >0         CM4 serviced the eDMA_LPSR completion IRQ (split-IRQ proof)
 *   err    = 00000000   DMA/transaction outcome (0 = OK)
 *   done   = 00000001   CM4 sequence completed
 * WIRE_DMA_CM4=PASS requires ready=CAFE0001, dmairq>0, err=0, done=1.
 * rdv is world-dependent -> printed but NOT folded into PASS (same discipline
 * as Phase 4.1's rdv).
 */
#include "Arduino.h"
#include "core_pins.h"
#include "HardwareSerial.h"
#include "Multicore.h"
#include "MessagingUnit.h"
#include "cm4_wire_dma.h"   /* generated by teensy_add_cm4_image */

#define WAIT_LONG 3000000u

static void phex(const char *k, uint32_t v)
{
    Serial1.print(k); Serial1.print('=');
    for (int i = 28; i >= 0; i -= 4)
        Serial1.print("0123456789ABCDEF"[(v >> i) & 0xF]);
    Serial1.println();
}
static void ptimeout(const char *k) { Serial1.print(k); Serial1.println("=TIMEOUT"); }

static bool wait_recv(uint8_t ch, uint32_t *out)
{
    for (uint32_t n = WAIT_LONG; n; n--)
        if (MU.tryReceive(ch, out)) return true;
    return false;
}

void setup()
{
    Serial1.begin(115200);
    Serial1.println("CM4WIREDMA-GATE v1");

    MU.begin();
    Multicore.begin(cm4_wire_dma, sizeof(cm4_wire_dma));

    static const char *labels[6] = { "ready", "croot", "rdv", "dmairq", "err", "done" };
    uint32_t v[6];
    bool ok = true;
    for (int i = 0; i < 6; i++) {
        if (wait_recv(0, &v[i])) phex(labels[i], v[i]);
        else { ptimeout(labels[i]); v[i] = 0xFFFFFFFFu; ok = false; }
    }

    /* rdv (v[2]) is world-dependent -> NOT folded into PASS. */
    bool pass = ok
        && v[0] == 0xCAFE0001u   /* ready: CM4 alive */
        && v[3] != 0x0u          /* dmairq: CM4 took the eDMA_LPSR completion IRQ */
        && v[4] == 0x0u          /* err: DMA/transaction OK */
        && v[5] == 0x1u;         /* done */
    /* croot printed for HW diagnosis; not asserted. */
    Serial1.println(pass ? "WIRE_DMA_CM4=PASS" : "WIRE_DMA_CM4=FAIL");
    Serial1.println("CM4WIREDMA-DONE");
}

void loop() {}
