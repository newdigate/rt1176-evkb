/*
 * cm4_audio_test (Plan 2 Task 3 capstone) -- the CM4 owns the WHOLE audio
 * pipeline; the CM7 boots the image and PARKS in WFI.
 *
 * The CM4 image: WM8962 codec over LPI2C5, interrupt-driven SAI1 I/O
 * (AudioOutputI2SInt/AudioInputI2SInt, no DMA), the AudioStream graph, and
 * CMSIS-DSP analyze_fft256 -- all on the M4. The CM7 does ZERO audio: it relays
 * the CM4's MU observations to LPUART1, reads back its OWN NVIC to prove no
 * SAI/eDMA audio interrupt was ever enabled on the CM7 (cm7_audio_isers=0),
 * then parks in a WFI loop servicing only the MU.
 *
 * Tokens over Serial1, streamed by the CM4 over MU channel 0 (in order):
 *   codec_ack     = 00000001  WM8962 brought up by the CM4 over LPI2C5
 *   sai_isr_count            SAI1 ISR entries on the CM4 NVIC
 *   dispatch_count           graph dispatches (TX 128-frame blocks)
 *   underruns     = 00000000  output graph-starve events
 *   fef           = 00000000  TX FIFO error (sticky TCSR.FEF)
 *   rx_overflows  = 00000000  RX FIFO overflow recoveries
 *   mic_peak_q15             mic level*32767 (HW only; ~0 in QEMU, world-split)
 *   fft_peak_bin  = 00000006  argmax |FFT| of the 1033.59 Hz sine tap
 *   fft_peak_mag             peak-bin magnitude
 *   done          = D0DE0005
 * Verdict AUDIO_CM4=PASS requires: codec_ack, sai_isr_count>1000,
 * dispatch_count>500, underruns==0, fef==0, rx_overflows==0, fft_peak_bin==6,
 * cm7_audio_isers==0. mic_peak is HW-only (QEMU has no acoustic source; asserted
 * >=0 only). HW adds: a human hears ~1 kHz on J101 from a CM4-owned pipeline.
 */
#include "Arduino.h"
#include "HardwareSerial.h"
#include "Multicore.h"
#include "MessagingUnit.h"
#include "cm4_audio.h"   /* generated by teensy_add_cm4_image(cm4_audio ...) */

#ifdef AUDIO_CM4_PLL_FALLBACK
/* ★★DOCUMENTED PROBE FALLBACK (spec §clocking, Plan-2 Task 3 step 4). The CM4
 * driving the ANATOP Audio PLL (AI writes) had no precedent -- the capstone HW
 * run IS that probe. If the PLL refuses to come up from the CM4 (HW-only
 * silence: sai_isr_count==0 + no tone while QEMU was green), the CM7 pre-arms
 * the SAME 44.1 kHz Audio PLL BEFORE booting the CM4 (a ~1-line CM7 concession;
 * the CM4 still owns the clock ROOT/LPCG/pads/SAI regs and everything else).
 * Enable by defining AUDIO_CM4_PLL_FALLBACK and linking Audio/sai1176.c (see
 * CMakeLists.txt). Leave OFF unless the HW probe fires -- report it as a
 * silicon finding, not a failure. */
extern "C" void sai1176_pll_init_44k(void);
#endif

// Wait for a CM4 MU token with a DWT-cycle deadline. The core enables
// ARM_DWT_CYCCNT in systick_init() (startup.c) -- it is already counting -- and
// DWT is the reliable time base on this silicon (SysTick/millis() is flaky:
// delay.c uses DWT for the same reason), so do NOT bound this with millis() or a
// raw iteration count. The CM4 emits NO token until it finishes
// DISPATCH_TARGET=1024 dispatches (~3.0 s at 44.1 kHz); a ~1 s iteration bound
// would time out and false-FAIL a perfectly healthy HW run while the tone plays.
static bool wait_recv(uint8_t ch, uint32_t *out, uint32_t max_cycles) {
    uint32_t start = ARM_DWT_CYCCNT;
    do {
        if (MU.tryReceive(ch, out)) return true;
    } while ((uint32_t)(ARM_DWT_CYCCNT - start) < max_cycles);
    return false;
}

static void phex(const char *k, uint32_t v) {
    Serial1.print(k);
    Serial1.print('=');
    for (int s = 28; s >= 0; s -= 4) Serial1.print("0123456789ABCDEF"[(v >> s) & 0xF]);
    Serial1.println();
}

// CM7 NVIC set-enable registers (Cortex-M7 SCS). Read-back proves the CM7 never
// enabled an audio interrupt: eDMA main channels = IRQ 0..15 (ISER0 bits 0..15),
// SAI1 = IRQ 76 (ISER2 bit 12). All must be 0 (the CM4 owns audio).
#define CM7_NVIC_ISER0 (*(volatile uint32_t *)0xE000E100u)
#define CM7_NVIC_ISER2 (*(volatile uint32_t *)0xE000E108u)

void setup() {
    Serial1.begin(115200);
    Serial1.println("CM4AUDIO-GATE v1");

    MU.begin();

#ifdef AUDIO_CM4_PLL_FALLBACK
    sai1176_pll_init_44k();   // pre-arm the Audio PLL before the CM4 boots
    Serial1.println("info pll_prearm=1 (CM7 fallback engaged)");
#endif

    Multicore.begin(cm4_audio, sizeof(cm4_audio));

    uint32_t codec_ack = 0, sai_isr = 0, disp = 0, under = 0, fef = 0,
             rx_ovf = 0, mic_q15 = 0, fft_bin = 0, fft_mag = 0, done = 0;
    // The FIRST token gates on the CM4's ~3 s measurement window; 4.2e9 cycles
    // (~4.2 s @ 996 MHz) covers it with ~1.2 s margin and stays < 2^32 = 4.295e9
    // so a single unsigned CYCCNT delta is wrap-safe. The remaining 9 tokens
    // follow within microseconds, so a 0.2 s bound is ample.
    const uint32_t FIRST_CYCLES = 4200000000u;   // ~4.2 s
    const uint32_t NEXT_CYCLES  =  200000000u;   // ~0.2 s
    bool ok = wait_recv(0, &codec_ack, FIRST_CYCLES) && wait_recv(0, &sai_isr, NEXT_CYCLES) &&
              wait_recv(0, &disp,   NEXT_CYCLES)      && wait_recv(0, &under,   NEXT_CYCLES) &&
              wait_recv(0, &fef,    NEXT_CYCLES)      && wait_recv(0, &rx_ovf,  NEXT_CYCLES) &&
              wait_recv(0, &mic_q15, NEXT_CYCLES)     && wait_recv(0, &fft_bin, NEXT_CYCLES) &&
              wait_recv(0, &fft_mag, NEXT_CYCLES)     && wait_recv(0, &done,    NEXT_CYCLES);

    phex("codec_ack",     codec_ack);
    phex("sai_isr_count", sai_isr);
    phex("dispatch_count", disp);
    phex("underruns",     under);
    phex("fef",           fef);
    phex("rx_overflows",  rx_ovf);
    phex("mic_peak_q15",  mic_q15);
    phex("fft_peak_bin",  fft_bin);
    phex("fft_peak_mag",  fft_mag);
    phex("done",          done);

    // The CM7's own NVIC: no audio interrupt was ever enabled here.
    uint32_t dma_bits = CM7_NVIC_ISER0 & 0x0000FFFFu;         // eDMA CH0..15
    uint32_t sai_bit  = (CM7_NVIC_ISER2 >> 12) & 0x1u;        // SAI1 (IRQ 76)
    uint32_t cm7_audio_isers = dma_bits | (sai_bit << 16);
    phex("cm7_audio_isers", cm7_audio_isers);

    bool pass = ok && codec_ack == 1u && sai_isr > 1000u && disp > 500u &&
                under == 0u && fef == 0u && rx_ovf == 0u &&
                fft_bin == 6u && cm7_audio_isers == 0u &&
                done == 0xD0DE0005u;
    Serial1.println(pass ? "AUDIO_CM4=PASS" : "AUDIO_CM4=FAIL");
    Serial1.println("HUMAN: listen for ~1 kHz on J101 (CM4-owned pipeline)");
    Serial1.println("CM4AUDIO-DONE");

    // Park: the CM7 has no audio work. A WFI loop that only ever wakes for the
    // MU -- proving the pipeline runs entirely on the CM4.
    for (;;) {
        uint32_t v;
        while (MU.tryReceive(0, &v)) { /* drain any late CM4 chatter */ }
        __asm volatile ("wfi");
    }
}

void loop() {}
