/*
 * cm4_intr_test - QEMU/HW gate for Phase-2C: CM4 NVIC + timing.
 *
 * Boots a real CM4 image that stands up its own interrupt + timing units and
 * reports over the MU:
 *   dwt=D00D0001   the CM4's DWT CYCCNT advanced (silicon-safe timing base,
 *                  the same primitive the CM7 core uses instead of SysTick)
 *   systick=<n>    number of CM4 SysTick exceptions counted — a CHARACTERISATION
 *                  probe, NOT asserted: RT1176 silicon's CM7 SysTick tick ISR is
 *                  known unreliable (delay.c), so whether the CM4's fires is a
 *                  genuine QEMU-vs-silicon question this gate measures.
 *   irqecho=ABCD0001  the CM4 handled the MU interrupt (NVIC IRQ 118) in its own
 *                  ISR and echoed CM7's message+1 -> proves CM4 external NVIC
 *                  dispatch (Phase 1 only proved the CM7 side of IRQ 118).
 *
 * One "token=HEXVALUE" line per observation over Serial1 so QEMU and EVKB
 * transcripts diff directly.
 */
#include "Arduino.h"
#include "core_pins.h"
#include "HardwareSerial.h"
#include "Multicore.h"
#include "MessagingUnit.h"
#include "cm4_intr.h"     /* generated by teensy_add_cm4_image */

#define WAIT_LONG 3000000u

static void phex(const char *k, uint32_t v)
{
    Serial1.print(k);
    Serial1.print('=');
    for (int i = 28; i >= 0; i -= 4) {
        Serial1.print("0123456789ABCDEF"[(v >> i) & 0xF]);
    }
    Serial1.println();
}

static void ptimeout(const char *k)
{
    Serial1.print(k);
    Serial1.println("=TIMEOUT");
}

static bool wait_recv(uint8_t ch, uint32_t *out)
{
    for (uint32_t n = WAIT_LONG; n; n--) {
        if (MU.tryReceive(ch, out)) {
            return true;
        }
    }
    return false;
}

void setup()
{
    uint32_t v;

    Serial1.begin(115200);
    Serial1.println("CM4INTR-GATE v1");

    MU.begin();

    bool ok = Multicore.begin(cm4_intr, sizeof(cm4_intr));
    phex("boot", ok ? 1u : 0u);
    phex("run", Multicore.running() ? 1u : 0u);

    /* DWT timing base advanced on the CM4 (asserted). */
    if (wait_recv(0, &v)) { phex("dwt", v); } else { ptimeout("dwt"); }

    /* CM4 SysTick exception count (characterisation probe — reported, not
     * asserted; the CM7 SysTick ISR is unreliable on RT1176 silicon). */
    if (wait_recv(1, &v)) { phex("systick", v); } else { ptimeout("systick"); }

    /* External NVIC IRQ 118: send a message; the CM4's MU ISR echoes it+1. */
    MU.send(3, 0xABCD0000u);
    if (wait_recv(3, &v)) { phex("irqecho", v); } else { ptimeout("irqecho"); }

    Serial1.println("CM4INTR-DONE");
}

void loop()
{
}
