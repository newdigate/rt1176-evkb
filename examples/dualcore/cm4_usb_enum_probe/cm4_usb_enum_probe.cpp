/*
 * cm4_usb_enum_probe -- Phase 7.2c of the CM4 USB arc: does the REAL
 * USBHost_t36 stack run on the Cortex-M4 and enumerate a device?
 *
 * 7.1 proved the CM4 can own the port with a hand-written register sequence and
 * take IRQ 135 on its own NVIC.  This goes the rest of the way: the CM4 image
 * links ehci.cpp + enumeration.cpp + hub.cpp + memory.cpp, calls
 * USBHost::begin(), and reports the attached device's VID/PID -- values it
 * cannot know except by fetching descriptors over the wire.
 *
 * CM7 role: boot the CM4 image and relay its MU observations to LPUART1.  The
 * CM7 configures NO USB register.  That is not tidiness -- a CM7 that touched
 * the block would make a CM4 failure invisible, the circular-pass shape 3.1
 * warned about.
 *
 * Tokens over Serial1, streamed by the CM4 over MU channel 0 as
 * (stage marker, observation) pairs, then results:
 *   s1/dwt      E5B00001 / cycle delta measured over a bounded spin.  ZERO here
 *                          means DEMCR.TRCENA / DWT_CTRL.CYCCNTENA did not take
 *                          and every clock in the shim is frozen -- which stops
 *                          every USBHost_t36 timeout from ever firing.  It is
 *                          the first token because that failure is otherwise
 *                          SILENT: enumeration would neither finish nor give up.
 *   s2/usbintr  E5B00002 / USBINTR after USBHost::begin() returned.  UAIE
 *                          (bit 18) must be set: enumeration completes every
 *                          control transfer through UAI -> followup_Transfer
 *                          (ehci.cpp:380).  7.1 armed PCE alone, which is
 *                          enough to see a plug and not enough to enumerate.
 *   s3/portsc   E5B00003 / PORTSC1 with the port armed and settled.  CCS(bit0)
 *                          is expected 0 -- the device arrives AFTER this
 *                          marker, which is what the gate polls for.
 *   s4/claims   E5B00004 / claim() call count.  ★ This is also the interrupt
 *                          evidence: claim() is reachable only via
 *                          claim_drivers <- enumeration_receive <-
 *                          followup_Transfer, which runs inside USBHost::isr().
 *                          There is no polled path to it, so claims>0 cannot
 *                          happen unless vector slot 151 dispatched IRQ 135 on
 *                          the CM4's own NVIC.
 *   vid         ........   THE ANSWER: the device's idVendor,
 *   pid         ........   and idProduct, from the fetched device descriptor.
 *   devinfo     ........   bDeviceClass<<24 | bDeviceSubClass<<16 |
 *                          speed<<8 | address  (speed: 0=12, 1=1.5, 2=480 Mbit)
 *   portsc2     ........   PORTSC1 after the window; CCS expected 1, so
 *                          portsc->portsc2 is a real 0->1 connect edge.
 *   stsraw      ........   USBSTS after the window.  Disambiguates a zero
 *                          claim count: bits still set mean the condition arose
 *                          and was never serviced (a vector-table problem),
 *                          all-clear means it never arose (a controller or
 *                          port problem).
 *   loops       ........   Task() iterations -- a spin and a hang look the same
 *                          in a truncated transcript otherwise.
 *   done        D0DE0008
 *
 * ENUM_CM4=PASS requires: every stage marker in order, the done marker, a live
 * DWT, UAIE armed, a 0->1 connect edge, claims>0, and a non-zero VID.  It is
 * deliberately DEVICE-AGNOSTIC so the same firmware serves the QEMU gate and a
 * hand-plugged device on J47; the gate asserts QEMU's usb-audio 46F4:0002 on
 * top, and that pair is the un-fakeable part -- it can only have come off the
 * wire.
 *
 * ★ THE CM7 STREAMS.  recv_show() prints each word as it arrives; do not tidy
 * it back into a batch of reads followed by a batch of prints.  The gate polls
 * the UART for s3 and hotplugs the moment it appears, so the connect event
 * lands inside the CM4's armed window.  Batch printing emits s3 only after ALL
 * words have arrived -- i.e. after the window has closed -- and the gate would
 * then plug too late and measure a failure that has nothing to do with the
 * stack.  Measured 2026-08-06 on 7.1: it looked identical to a real defect.
 */
#include "Arduino.h"
#include "HardwareSerial.h"
#include "Multicore.h"
#include "MessagingUnit.h"
#include "cm4_usb_enum.h"   /* generated by teensy_add_cm4_image(cm4_usb_enum ...) */

/* Wall-clock, not an iteration count.  The CM4's observation window is 12 s and
 * it waits for a hotplug inside it, so the CM7 must outlast that by a margin;
 * 30 s covers the window plus PHY bring-up plus the emulator running slower
 * than wall-clock.  Anything past that is a genuine hang, reported as the
 * missing token rather than by blocking the gate forever. */
static bool wait_recv(uint8_t ch, uint32_t *out) {
    uint32_t start = millis();
    while ((uint32_t)(millis() - start) < 30000u) {
        if (MU.tryReceive(ch, out)) return true;
    }
    return false;
}

static void phex(const char *k, uint32_t v) {
    Serial1.print(k);
    Serial1.print('=');
    for (int s = 28; s >= 0; s -= 4) Serial1.print("0123456789ABCDEF"[(v >> s) & 0xF]);
    Serial1.println();
}

/* Receive one word and print it IMMEDIATELY -- see the ★ note in the header. */
static bool recv_show(const char *k, uint32_t *out) {
    if (!wait_recv(0, out)) return false;
    phex(k, *out);
    return true;
}

void setup() {
    Serial1.begin(115200);
    Serial1.println("CM4USBENUM-GATE v1");

    MU.begin();
    Multicore.begin(cm4_usb_enum, sizeof(cm4_usb_enum));

    uint32_t s1 = 0, dwt = 0, s2 = 0, usbintr = 0, s3 = 0, portsc = 0;
    uint32_t s4 = 0, claims = 0, vid = 0, pid = 0, devinfo = 0;
    uint32_t portsc2 = 0, stsraw = 0, loops = 0, done = 0;

    bool ok = recv_show("s1",      &s1)      && recv_show("dwt",     &dwt)
           && recv_show("s2",      &s2)      && recv_show("usbintr", &usbintr)
           && recv_show("s3",      &s3)      && recv_show("portsc",  &portsc)
           && recv_show("s4",      &s4)      && recv_show("claims",  &claims)
           && recv_show("vid",     &vid)     && recv_show("pid",     &pid)
           && recv_show("devinfo", &devinfo)
           && recv_show("portsc2", &portsc2) && recv_show("stsraw",  &stsraw)
           && recv_show("loops",   &loops)   && recv_show("done",    &done);

    /* Decoded, so a human reading the transcript does not have to remember bit
     * positions -- and so a wrong decode is visible rather than latent. */
    Serial1.print("decode: uaie=");   Serial1.print((usbintr >> 18) & 1u);
    Serial1.print(" upie=");          Serial1.print((usbintr >> 19) & 1u);
    Serial1.print(" pce=");           Serial1.print((usbintr >>  2) & 1u);
    Serial1.print(" ccs=");           Serial1.print(portsc  & 1u);
    Serial1.print(" ccs2=");          Serial1.print(portsc2 & 1u);
    Serial1.print(" class=0x");       Serial1.print((devinfo >> 24) & 0xFFu, HEX);
    Serial1.print(" speed=");         Serial1.print((devinfo >> 8) & 0xFFu);
    Serial1.print(" addr=");          Serial1.print(devinfo & 0xFFu);
    Serial1.println();

    bool stages = (s1 == 0xE5B00001u) && (s2 == 0xE5B00002u) && (s3 == 0xE5B00003u)
               && (s4 == 0xE5B00004u) && (done == 0xD0DE0008u);
    /* Each verdict is its own line, ordered so a red run localises itself:
     * a dead clock, an unarmed mask, a device that never arrived, an interrupt
     * that never dispatched, and a descriptor that never came back are five
     * different faults and must not collapse into one FAIL. */
    bool clock = dwt != 0u;
    bool intr  = ((usbintr >> 18) & 1u) != 0u;   /* UAIE: the enumeration path */
    bool plug  = ((portsc & 1u) == 0u) && ((portsc2 & 1u) == 1u);
    bool isr   = claims > 0u;
    bool desc  = vid != 0u;

    Serial1.println(stages ? "STAGES=PASS"      : "STAGES=FAIL");
    Serial1.println(clock  ? "DWT_ALIVE=PASS"   : "DWT_ALIVE=FAIL");
    Serial1.println(intr   ? "USBINTR_UAIE=PASS": "USBINTR_UAIE=FAIL");
    Serial1.println(plug   ? "PLUG_TRANSITION=PASS" : "PLUG_TRANSITION=FAIL");
    Serial1.println(isr    ? "CLAIM_CALLED=PASS": "CLAIM_CALLED=FAIL");
    Serial1.println(desc   ? "DESCRIPTOR_FETCHED=PASS" : "DESCRIPTOR_FETCHED=FAIL");

    bool pass = ok && stages && clock && intr && plug && isr && desc;
    Serial1.println(pass ? "ENUM_CM4=PASS" : "ENUM_CM4=FAIL");
    Serial1.println("CM4USBENUM-DONE");
}

void loop() {}
