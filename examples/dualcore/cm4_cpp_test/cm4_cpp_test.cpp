/*
 * cm4_cpp_test — the CM4 image world's C++-runtime gate: teensy_add_cm4_image
 * compiled a .cpp CM4 image (arm-none-eabi-g++, -fno-exceptions -fno-rtti
 * -fno-threadsafe-statics -fno-use-cxa-atexit) and the freestanding runtime
 * works on the M4: static constructors (.init_array walked by cm4_run_ctors),
 * virtual dispatch through a Base pointer, and the -nostdlib stubs.
 *
 * CM7 role: boot the CM4 C++ image, relay its MU observations to LPUART1.
 *
 * Tokens over Serial1, streamed by the CM4 over MU channel 0:
 *   ctor = CAFEC201   a static object's constructor ran before main
 *   virt = CAFEC202   Derived::id() reached through a Base pointer (vtable)
 *   done = D0DE0002   CM4 sequence completed
 * Verdict: CPP_CM4=PASS requires all three exact values.
 */
#include "Arduino.h"
#include "HardwareSerial.h"
#include "Multicore.h"
#include "MessagingUnit.h"
#include "cm4_cpp.h"   /* generated by teensy_add_cm4_image(cm4_cpp ...) */

static bool wait_recv(uint8_t ch, uint32_t *out) {
    for (uint32_t i = 0; i < 3000000u; i++) {
        if (MU.tryReceive(ch, out)) return true;
    }
    return false;
}

static void phex(const char *k, uint32_t v) {
    Serial1.print(k);
    Serial1.print('=');
    for (int s = 28; s >= 0; s -= 4) Serial1.print("0123456789ABCDEF"[(v >> s) & 0xF]);
    Serial1.println();
}

void setup() {
    Serial1.begin(115200);
    Serial1.println("CM4CPP-GATE v1");

    MU.begin();
    Multicore.begin(cm4_cpp, sizeof(cm4_cpp));

    uint32_t ctor = 0, virt = 0, done = 0;
    bool ok = wait_recv(0, &ctor) && wait_recv(0, &virt) && wait_recv(0, &done);
    phex("ctor", ctor);
    phex("virt", virt);
    phex("done", done);
    bool pass = ok && ctor == 0xCAFEC201u && virt == 0xCAFEC202u && done == 0xD0DE0002u;
    Serial1.println(pass ? "CPP_CM4=PASS" : "CPP_CM4=FAIL");
    Serial1.println("CM4CPP-DONE");
}

void loop() {}
