/*
 * cm4_spi_dma_test — Phase 4.3: the CM4 self-configures LPSPI1 and runs
 * full-duplex DMA self-loopback (SDO->SDI jumper) in two stages: STAGE_BLOCKING
 * (poll the RX eDMA channel DONE) and STAGE_ASYNC (the RX major-complete IRQ
 * fires on the CM4's OWN NVIC via the eDMA split-IRQ — dmairq>0 is the isolated
 * routing proof). The CM7 only boots the CM4 image and reports MU tokens.
 *
 * Silicon-truth (world-split, same as cm4_spi_test 3.1): the qemu2 ssi-loopback
 * echoes on CR.MEN ALONE, so rxb/rxa==1 in QEMU proves only the TCD/DMA
 * sequence; the real SDO->SDI jumper on HW proves the CM4 ungated the clock +
 * muxed the pins + drove a real DMA-fed SCK.
 *
 * Tokens (MU ch0, fixed order after READY):
 *   ready  = CAFE0001   CM4 alive
 *   cr     = 00000001   LPSPI CR.MEN — master enabled
 *   cfgr1  = 00000001   CFGR1.MASTER
 *   lpcg   = ........   CCM_LPCG104 readback (informative)
 *   croot  = ........   CCM_CLOCK_ROOT43 readback (informative)
 *   rxb    = 00000001   STAGE_BLOCKING rx==tx (poll DONE)
 *   dmairq = >0         CM4 serviced the eDMA RX completion IRQ (split proof)
 *   rxa    = 00000001   STAGE_ASYNC rx==tx (interrupt-driven)
 *   done   = 00000001   CM4 sequence completed
 * SPI_DMA_CM4=PASS requires cr=1, cfgr1=1, rxb=1, dmairq>0, rxa=1, done=1.
 */
#include "Arduino.h"
#include "core_pins.h"
#include "HardwareSerial.h"
#include "Multicore.h"
#include "MessagingUnit.h"
#include "cm4_spi_dma.h"   /* generated by teensy_add_cm4_image */

#define WAIT_LONG 3000000u

static void phex(const char *k, uint32_t v)
{
    Serial1.print(k); Serial1.print('=');
    for (int i = 28; i >= 0; i -= 4)
        Serial1.print("0123456789ABCDEF"[(v >> i) & 0xF]);
    Serial1.println();
}
static void ptimeout(const char *k) { Serial1.print(k); Serial1.println("=TIMEOUT"); }

static bool wait_recv(uint8_t ch, uint32_t *out)
{
    for (uint32_t n = WAIT_LONG; n; n--)
        if (MU.tryReceive(ch, out)) return true;
    return false;
}

void setup()
{
    Serial1.begin(115200);
    Serial1.println("CM4SPIDMA-GATE v1");

    MU.begin();
    Multicore.begin(cm4_spi_dma, sizeof(cm4_spi_dma));

    static const char *labels[9] =
        { "ready", "cr", "cfgr1", "lpcg", "croot", "rxb", "dmairq", "rxa", "done" };
    uint32_t v[9];
    bool ok = true;
    for (int i = 0; i < 9; i++) {
        if (wait_recv(0, &v[i])) phex(labels[i], v[i]);
        else { ptimeout(labels[i]); v[i] = 0xFFFFFFFFu; ok = false; }
    }

    /* POLLED-only PASS: this test drives the MAIN eDMA, whose completion IRQ is
     * CM7-only on silicon (two-eDMA finding — rt1176-cm4-edma-lpsr-split). So
     * dmairq (v[6]) is EXPECTED 0 and NOT folded into PASS; the CM4 DMA proof is
     * the polled data path (rxb/rxa). Genuine CM4 interrupt-DMA = cm4_wire_dma_test
     * (eDMA_LPSR). */
    bool pass = ok
        && v[0] == 0xCAFE0001u
        && v[1] == 0x1u          /* cr.MEN */
        && v[2] == 0x1u          /* cfgr1.MASTER */
        && v[5] == 0x1u          /* rxb: blocking DMA rx==tx (polled) */
        && v[7] == 0x1u          /* rxa: async-stage data rx==tx (completes w/o the IRQ) */
        && v[8] == 0x1u;         /* done */
    /* lpcg/croot printed for HW diagnosis; not asserted. */
    Serial1.println(pass ? "SPI_DMA_CM4=PASS" : "SPI_DMA_CM4=FAIL");
    Serial1.println("CM4SPIDMA-DONE");
}

void loop() {}
