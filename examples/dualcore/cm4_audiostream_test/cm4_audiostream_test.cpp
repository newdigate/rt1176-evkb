/*
 * cm4_audiostream_test — the AudioStream graph engine runs on the CM4: the
 * CM4 image compiles the real cores/imxrt1176/AudioStream.cpp (unmodified)
 * against the cores/imxrt1176/cm4_shim Arduino-lite header, drives the
 * audiostream_test synthetic graph (TestSource -> TestSink) by pending
 * IRQ_SOFTWARE (44, the repurposed-CAN1 slot — same convention as the CM7
 * world) 8 times, and asserts block flow + zero pool leak on the M4 itself.
 *
 * CM7 role: boot the CM4 image, relay its MU observations to LPUART1.
 *
 * Tokens over Serial1, streamed by the CM4 over MU channel 0:
 *   flow   = 00000001  8 blocks flowed source->sink, values 0..7 in order
 *   noleak = 00000001  AudioMemoryUsage() drained back to 0
 *   recv   = 00000008  sink received-block count
 *   memmax = pool high-water mark (info)
 *   done   = D0DE0003  CM4 sequence completed
 * Verdict: AUDIOSTREAM_CM4=PASS requires flow, noleak, recv>=8 and done.
 */
#include "Arduino.h"
#include "HardwareSerial.h"
#include "Multicore.h"
#include "MessagingUnit.h"
#include "cm4_audiostream.h"   /* generated by teensy_add_cm4_image(cm4_audiostream ...) */

static bool wait_recv(uint8_t ch, uint32_t *out) {
    for (uint32_t i = 0; i < 3000000u; i++) {
        if (MU.tryReceive(ch, out)) return true;
    }
    return false;
}

static void phex(const char *k, uint32_t v) {
    Serial1.print(k);
    Serial1.print('=');
    for (int s = 28; s >= 0; s -= 4) Serial1.print("0123456789ABCDEF"[(v >> s) & 0xF]);
    Serial1.println();
}

void setup() {
    Serial1.begin(115200);
    Serial1.println("CM4AUDIOSTREAM-GATE v1");

    MU.begin();
    Multicore.begin(cm4_audiostream, sizeof(cm4_audiostream));

    uint32_t flow = 0, noleak = 0, recv = 0, memmax = 0, done = 0;
    bool ok = wait_recv(0, &flow) && wait_recv(0, &noleak) && wait_recv(0, &recv)
           && wait_recv(0, &memmax) && wait_recv(0, &done);
    phex("flow",   flow);
    phex("noleak", noleak);
    phex("recv",   recv);
    phex("memmax", memmax);
    phex("done",   done);
    bool pass = ok && flow == 1u && noleak == 1u && recv >= 8u && done == 0xD0DE0003u;
    Serial1.println(pass ? "AUDIOSTREAM_CM4=PASS" : "AUDIOSTREAM_CM4=FAIL");
    Serial1.println("CM4AUDIOSTREAM-DONE");
}

void loop() {}
