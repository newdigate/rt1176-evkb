/* cm4_fft_test CM4 firmware: CMSIS-DSP known-answer tests ON THE M4.
 * Port of examples/framework/arm_math_test/arm_math_test.cpp's three stages
 * to the freestanding CM4 image world (no Serial, no libm, no libc):
 *   FFT  — 256-pt radix-4 complex q15 FFT of a hardcoded cos(2*pi*8*i/256)
 *          input at 0.5 FS; all energy must land in bin 8;
 *   FIR  — unit impulse through an 8-tap q15 FIR echoes the coefficients;
 *   SIN  — arm_sin_q31 at 5 fixed table-point angles vs precomputed q31
 *          values (replaces the CM7 test's libm sinf sweep: sinTable_q31 is
 *          exactly round(sin(2*pi*k/512)*2^31) and interpolation is exact at
 *          table points, so a +/-215-count tolerance is both generous and
 *          far below the CM7 test's 1e-4 bar).
 * The image stays -nostdlib: input/expected tables are generated offline
 * (one-liners in comments below) instead of calling cosf/sinf at runtime.
 *
 * Reported over MU channel 0, in order:
 *   fft_bin   best bin 1..127 (0xFFFFFFFF if the 4*second-peak margin failed)
 *   fft_mag2  re^2+im^2 of the best bin
 *   fir_ok    1/0
 *   sin_ok    1/0
 *   done      0xD0DE0004
 * CM7 relay asserts fft_bin==8, fft_mag2 in [5e7,9e7], fir_ok, sin_ok.
 *
 * NOTE: the shared startup_cm4.S enters `main` with PRIMASK set — irrelevant
 * here, no interrupts are used. Public domain (N. Newdigate). */
#include <stdint.h>
#include <arm_math.h>
extern "C" {
#include "mu_report.h"
void cm4_run_ctors(void);
}

static inline int32_t iabs32(int32_t v) { return v < 0 ? -v : v; }

/* STAGE_FFT input: (q15_t)lrint(16384*cos(2*pi*8*i/256)) for i in 0..255,
 * interleaved with zero imaginary parts at runtime. Generated by:
 *   python3 -c "import math; vals=[int(round(16384*math.cos(2*math.pi*8*i/256)))
 *     for i in range(256)]; print(',\n'.join(', '.join('%6d'%v
 *     for v in vals[j:j+8]) for j in range(0,256,8)))"
 * (The cos has period 32 samples, hence the visibly repeating rows.) */
static const q15_t fft_input[256] = {
     16384,  16069,  15137,  13623,  11585,   9102,   6270,   3196,
         0,  -3196,  -6270,  -9102, -11585, -13623, -15137, -16069,
    -16384, -16069, -15137, -13623, -11585,  -9102,  -6270,  -3196,
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         0,   3196,   6270,   9102,  11585,  13623,  15137,  16069
};

static q15_t fft_buf[512];   /* DTCM .bss: 256 complex q15 pairs, in-place */

/* Reports fft_bin (0xFFFFFFFF when the margin check fails) and fft_mag2. */
static void stage_fft(uint32_t *out_bin, uint32_t *out_mag2) {
    arm_cfft_radix4_instance_q15 inst;
    if (arm_cfft_radix4_init_q15(&inst, 256, 0, 1) != ARM_MATH_SUCCESS) {
        *out_bin = 0xFFFFFFFEu; *out_mag2 = 0;
        return;
    }
    for (int i = 0; i < 256; i++) {
        fft_buf[2 * i]     = fft_input[i];
        fft_buf[2 * i + 1] = 0;
    }
    arm_cfft_radix4_q15(&inst, fft_buf);          /* in-place, scaled 1/N */
    uint32_t best = 0, best_mag = 0, second = 0;
    for (uint32_t k = 1; k < 128; k++) {
        int32_t re = fft_buf[2 * k], im = fft_buf[2 * k + 1];
        uint32_t mag = (uint32_t)(re * re) + (uint32_t)(im * im);
        if (mag > best_mag) { second = best_mag; best_mag = mag; best = k; }
        else if (mag > second) { second = mag; }
    }
    /* Fold the spectral-purity margin into the reported bin: the CM7 asserts
     * bin==8, so a margin failure fails the gate visibly. */
    *out_bin  = (best_mag > 4 * second) ? best : 0xFFFFFFFFu;
    *out_mag2 = best_mag;
}

/* STAGE_FIR: unit impulse through an 8-tap FIR echoes the coefficients. */
static const q15_t fir_coeffs[8] = {1000, 2000, 3000, 4000, 4000, 3000, 2000, 1000};
static q15_t fir_state[8 + 32 - 1];
static uint32_t stage_fir(void) {
    arm_fir_instance_q15 f;
    if (arm_fir_init_q15(&f, 8, fir_coeffs, fir_state, 32) != ARM_MATH_SUCCESS)
        return 0;
    q15_t x[32] = {0}, y[32] = {0};
    x[0] = 32767;                                  /* ~1.0 in q15 */
    arm_fir_fast_q15(&f, x, y, 32);
    for (int i = 0; i < 8; i++)
        if (iabs32((int32_t)y[i] - (int32_t)fir_coeffs[i]) > 4) return 0;
    for (int i = 8; i < 32; i++)
        if (iabs32((int32_t)y[i]) > 4) return 0;
    return 1;
}

/* STAGE_SIN: arm_sin_q31 known-answer spot check, no libm. Angles are k/64 of
 * a turn (q31 angle = k*2^31/64 = k*33554432) — all exact sinTable_q31 entries
 * (64 divides FAST_MATH_TABLE_SIZE=512), where interpolation error is <=2
 * counts and the table itself is round(sin(2*pi*k/512)*2^31) exactly.
 * Expected values generated by:
 *   python3 -c "import math; [print(k, k*33554432,
 *     int(round(math.sin(2*math.pi*k/64)*2**31))) for k in [5,13,27,41,59]]"
 * Tolerance +/-215 counts: ~1e-7 of q31 full scale — far tighter than the CM7
 * test's 1e-4 float tolerance, affordable because the angles are exact table
 * points; still >100x headroom over the <=2-count true error. */
static const q31_t sin_angles[5]   = {  167772160,  436207616,  905969664,
                                       1375731712, 1979711488 };
static const q31_t sin_expected[5] = { 1012316784, 2055013723, 1012316784,
                                      -1660027308, -1012316784 };
static uint32_t stage_sin(void) {
    for (int i = 0; i < 5; i++) {
        q31_t got = arm_sin_q31(sin_angles[i]);
        if (iabs32(got - sin_expected[i]) > 215) return 0;
    }
    return 1;
}

extern "C" int main(void) {
    cm4_run_ctors();
    uint32_t fft_bin = 0, fft_mag2 = 0;
    stage_fft(&fft_bin, &fft_mag2);
    uint32_t fir_ok = stage_fir();
    uint32_t sin_ok = stage_sin();
    mu_send(fft_bin);
    mu_send(fft_mag2);
    mu_send(fir_ok);
    mu_send(sin_ok);
    mu_send(0xD0DE0004u);
    for (;;) { __asm volatile ("wfi"); }
}
