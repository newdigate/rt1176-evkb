/*
 * cm4_fft_test — CMSIS-DSP on the M4: the CM4 image compiles the CMSIS-DSP
 * amalgams (evkb_cmsis_dsp_cm4_sources -> teensy_add_cm4_image SOURCES/
 * INCLUDE_DIRS) and runs three known-answer stages ported from
 * examples/framework/arm_math_test (FFT bin-8, FIR impulse echo, arm_sin_q31
 * spot check). Pure CPU math — identical output expected in QEMU and on
 * silicon.
 *
 * CM7 role: boot the CM4 image, relay its MU observations to LPUART1, assert.
 *
 * Tokens over Serial1, streamed by the CM4 over MU channel 0 (in order):
 *   fft_bin  = 00000008   best FFT bin (0xFFFFFFFF = spectral margin failed)
 *   fft_mag2 in [5e7,9e7] re^2+im^2 of the best bin
 *   fir_ok   = 00000001
 *   sin_ok   = 00000001
 *   done     = D0DE0004
 * Verdict: FFT_CM4=PASS requires all of the above.
 */
#include "Arduino.h"
#include "HardwareSerial.h"
#include "Multicore.h"
#include "MessagingUnit.h"
#include "cm4_fft.h"   /* generated by teensy_add_cm4_image(cm4_fft ...) */

static bool wait_recv(uint8_t ch, uint32_t *out) {
    for (uint32_t i = 0; i < 3000000u; i++) {
        if (MU.tryReceive(ch, out)) return true;
    }
    return false;
}

static void phex(const char *k, uint32_t v) {
    Serial1.print(k);
    Serial1.print('=');
    for (int s = 28; s >= 0; s -= 4) Serial1.print("0123456789ABCDEF"[(v >> s) & 0xF]);
    Serial1.println();
}

void setup() {
    Serial1.begin(115200);
    Serial1.println("CM4FFT-GATE v1");

    MU.begin();
    Multicore.begin(cm4_fft, sizeof(cm4_fft));

    uint32_t fft_bin = 0, fft_mag2 = 0, fir_ok = 0, sin_ok = 0, done = 0;
    bool ok = wait_recv(0, &fft_bin) && wait_recv(0, &fft_mag2) &&
              wait_recv(0, &fir_ok)  && wait_recv(0, &sin_ok)   &&
              wait_recv(0, &done);
    phex("fft_bin",  fft_bin);
    phex("fft_mag2", fft_mag2);
    phex("fir_ok",   fir_ok);
    phex("sin_ok",   sin_ok);
    phex("done",     done);
    Serial1.print("fft_mag2_dec=");
    Serial1.println(fft_mag2);
    bool pass = ok && fft_bin == 8u &&
                fft_mag2 > 50000000u && fft_mag2 < 90000000u &&
                fir_ok == 1u && sin_ok == 1u && done == 0xD0DE0004u;
    Serial1.println(pass ? "FFT_CM4=PASS" : "FFT_CM4=FAIL");
    Serial1.println("CM4FFT-DONE");
}

void loop() {}
