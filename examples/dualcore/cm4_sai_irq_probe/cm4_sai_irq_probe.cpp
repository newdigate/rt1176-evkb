/*
 * cm4_sai_irq_probe — the phase-gating silicon probe for CM4 audio: does
 * SAI1's FIFO-request interrupt (IRQ 76 per RM Table 4-2) reach the CM4
 * NVIC on real silicon? The RM's IRQ tables lied about fast-GPIO, so the
 * table is not trusted without this probe.
 *
 * CM7 role: boot the CM4 probe image, relay its MU observations to LPUART1.
 * The CM7 does NOT touch SAI1 (single-owner rule: this probe's owner is
 * the CM4).
 *
 * Tokens over Serial1, streamed by the CM4 over MU channel 0:
 *   ready  = CAFE0001   CM4 configured SAI1 TX, about to enable FRIE
 *   irqcnt = ........   number of SAI1_IRQHandler entries (the answer; >0 = PASS)
 *   flags  = .......X   TCSR FRF/FWF/FEF snapshot after the spin
 *   done   = D0DE0001   CM4 sequence completed
 * Verdict: SAI_IRQ_CM4=PASS requires ready/done markers and irqcnt > 0.
 *
 * QEMU is EXPECTED-FAIL until the model fans SAI1 IRQ 76 to both NVICs
 * (qemu2 wires SAI IRQs CM7-only today); the EVKB is the oracle.
 */
#include "Arduino.h"
#include "HardwareSerial.h"
#include "Multicore.h"
#include "MessagingUnit.h"
#include "cm4_sai_probe.h"   /* generated by teensy_add_cm4_image(cm4_sai_probe ...) */

static bool wait_recv(uint8_t ch, uint32_t *out) {
    for (uint32_t i = 0; i < 3000000u; i++) {
        if (MU.tryReceive(ch, out)) return true;
    }
    return false;
}

static void phex(const char *k, uint32_t v) {
    Serial1.print(k);
    Serial1.print('=');
    for (int s = 28; s >= 0; s -= 4) Serial1.print("0123456789ABCDEF"[(v >> s) & 0xF]);
    Serial1.println();
}

void setup() {
    Serial1.begin(115200);
    Serial1.println("CM4SAIIRQ-GATE v1");

    MU.begin();
    Multicore.begin(cm4_sai_probe, sizeof(cm4_sai_probe));

    uint32_t ready = 0, irqcnt = 0, flags = 0, done = 0;
    bool ok = wait_recv(0, &ready) && wait_recv(0, &irqcnt)
           && wait_recv(0, &flags) && wait_recv(0, &done);
    phex("ready",  ready);
    phex("irqcnt", irqcnt);
    phex("flags",  flags);
    phex("done",   done);
    bool pass = ok && ready == 0xCAFE0001u && done == 0xD0DE0001u && irqcnt > 0u;
    Serial1.println(pass ? "SAI_IRQ_CM4=PASS" : "SAI_IRQ_CM4=FAIL");
    Serial1.println("CM4SAIIRQ-DONE");
}

void loop() {}
